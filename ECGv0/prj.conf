## CMakeLists.txt
```
# SPDX-License-Identifier: Apache-2.0

# This is a general purpose project created from MotionSenseHRV to be used for data collection.

# Ohio State SENSE LAB
cmake_minimum_required(VERSION 3.20.0)

# Preserve direct (non-sysbuild) configuration as well. Sysbuild receives the
# same repository board root from sysbuild/CMakeLists.txt before child images
# are configured.
list(APPEND BOARD_ROOT "${CMAKE_CURRENT_SOURCE_DIR}/..")

list(APPEND ZEPHYR_EXTRA_MODULES "${CMAKE_CURRENT_SOURCE_DIR}/../shared")


find_package(Zephyr REQUIRED HINTS $ENV{ZEPHYR_BASE})
project(ECGv0)

preprocess_pm_yml(
	"${CMAKE_CURRENT_SOURCE_DIR}/pm.yml"
	"${CMAKE_CURRENT_BINARY_DIR}/pm.yml.msense_fatal_retention"
)

include("${ZEPHYR_MSENSE_SHARED_MODULE_DIR}/cmake/msense_git_metadata.cmake")
msense_add_git_metadata("${CMAKE_CURRENT_SOURCE_DIR}")

include(CTest)
if(BUILD_TESTING)
	add_test(
		NAME msense_storage_geometry
		COMMAND ${CMAKE_COMMAND}
			"-DMSENSE_SOURCE_ROOT=${CMAKE_CURRENT_SOURCE_DIR}/.."
			-P "${CMAKE_CURRENT_SOURCE_DIR}/../shared/tests/cmake/test_storage_geometry.cmake"
	)
	add_test(
		NAME msense_sensor_stream_geometry
		COMMAND ${CMAKE_COMMAND}
			"-DMSENSE_SOURCE_ROOT=${CMAKE_CURRENT_SOURCE_DIR}/.."
			-P "${CMAKE_CURRENT_SOURCE_DIR}/../shared/tests/cmake/test_sensor_stream_geometry.cmake"
	)
	add_test(
		NAME msense_phase4_contracts
		COMMAND ${CMAKE_COMMAND}
			"-DMSENSE_SOURCE_ROOT=${CMAKE_CURRENT_SOURCE_DIR}/.."
			"-DMSENSE_PRODUCT=ECGv0"
			"-DMSENSE_APP_BUILD_DIR=${CMAKE_CURRENT_BINARY_DIR}"
			-P "${CMAKE_CURRENT_SOURCE_DIR}/../shared/tests/cmake/test_phase4_contracts.cmake"
	)
endif()

set(CMAKE_OBJECT_PATH_MAX 380)
if((NOT CONFIG_DISK_DRIVER_FLASH) AND
   (NOT CONFIG_DISK_DRIVER_RAM) AND
   (NOT CONFIG_DISK_DRIVER_SDMMC))
	message(WARNING "No disk access settings detected." )
endif()
target_compile_options(app PRIVATE -Wno-unused-function)

target_include_directories(app PRIVATE
	"${ZEPHYR_MSENSE_SHARED_MODULE_DIR}/include"
	"${ZEPHYR_MSENSE_SHARED_MODULE_DIR}/drivers/nand"
	"${ZEPHYR_MSENSE_SHARED_MODULE_DIR}/drivers/nor"
)

target_sources(app PRIVATE
	src/BLEService.c
	src/accelRecordFormat.c
	src/accelRecorder.c
	src/accelTimingEstimator.c
	src/batterymonitordt.c
	src/ecgRecorder.c
	src/filesystemlogging_policy.c
	src/icm20948_accel.c
	src/icm20948_fifo_count.c
	src/imuFsyncTiming.c
	src/main.c
	src/zephyrfilesystem.c
	src/drivers/ecg/max30001.c
	../shared/fatal_retention.c
)

#if(CONFIG_BUILD_WITH_TFM)
#  target_include_directories(app PRIVATE
#    $<TARGET_PROPERTY:tfm,TFM_BINARY_DIR>/install/interface/include
#  )
#endif()
```

## Kconfig
```
# Copyright (c) 2019-2020 Nordic Semiconductor ASA
# SPDX-License-Identifier: Apache-2.0

config APP_WIPE_STORAGE
	bool "Option to clear the flash area before mounting"
	help
	  Use this to force an existing file system to be created.

choice
	prompt "Storage and file system type used by the application"
	default APP_MSC_STORAGE_NONE
	help
	  Specify the type of storage and file system.

config APP_MSC_STORAGE_NONE
	bool "Use RAM disk as block device"
	imply DISK_DRIVER_RAM

config APP_MSC_STORAGE_RAM
	bool "Use RAM disk and FAT file system"
	imply DISK_DRIVER_RAM
	imply FILE_SYSTEM
	imply FAT_FILESYSTEM_ELM

config APP_MSC_STORAGE_FLASH_FATFS
	bool "Use FLASH disk and FAT file system"
	imply DISK_DRIVER_FLASH
	imply FILE_SYSTEM
	imply FAT_FILESYSTEM_ELM

config APP_MSC_STORAGE_FLASH_LITTLEFS
	bool "Use FLASH disk and LittleFS"
	imply DISK_DRIVER_FLASH
	imply FILE_SYSTEM
	imply FILE_SYSTEM_LITTLEFS

config APP_MSC_STORAGE_SDCARD
	bool "Use SDHC and FAT file system"
	imply DISK_DRIVER_SDMMC
	imply FILE_SYSTEM
	imply FAT_FILESYSTEM_ELM

endchoice


config MASS_STORAGE_DISK_NAME
	default "MX25R64" if DISK_DRIVER_FLASH
	default "RAM" if DISK_DRIVER_RAM
	default "SD" if DISK_DRIVER_SDMMC

if DISK_DRIVER_FLASH

config FLASH_MAP
	default y

config FLASH_PAGE_LAYOUT
	default y

config FLASH_LOG_LEVEL
	default 3

if NORDIC_QSPI_NOR

config NORDIC_QSPI_NOR_FLASH_LAYOUT_PAGE_SIZE
	default 4096

endif # NORDIC_QSPI_NOR

endif # DISK_DRIVER_FLASH

menuconfig COLLECTION_REQUIRES_DATE_ID
	bool "Allows sensor collection only if the date time and id characteristics have been filled out by the central."
	default n


config USB_ALWAYS_ON
	bool "whether the usb mass storage driver is on during bluetooth collection"
	default n
	help
		Normally, when data collection starts the USB module turns off, preventing the user from being able to read the drive 
		while data collection is taking place. This KConfig disables this, allowing users to always see logs

config USB_WRITABLE
	bool "whether one can write or modify files via USB"
	default n
	help 
		If the device is plugged in via USB and this KConfig is not set, Users will not be able to create or write new files
		(they can still read them).
		for this to truly work, we must be using a file system driver that supports reading and writing, 
		like flash area (NOR) or dhara (NAND)

config MSENSE_USB_SECURITY
	bool "Configures USB security mode, which requires a password in order to enable to usb behavior. Not Currently Implemented."
	default n

config LOG_BACKEND_FS_BUFFER
    bool "file buffered log backend"
    depends on LOG
    select LOG_OUTPUT
    help
      When enabled, the double buffered filesystem backend is used for logging.


config LOG_LEVEL_ICM20948_ACCEL
	int "ICM-20948 accelerometer log level"
	default 3

config LOG_LEVEL_MAX30001
	int "level at which data from MAX30001 is printed in logs"
	default 3

source "Kconfig.zephyr"
```

## sysbuild.conf
```
SB_CONFIG_BOOTLOADER_MCUBOOT=y
SB_CONFIG_NETCORE_HCI_IPC=y
```

## prj.conf
```kconfig
#CONFIG_NCS_SAMPLES_DEFAULTS=y

CONFIG_STDOUT_CONSOLE=y

# deprecated:
#CONFIG_CPLUSPLUS=y
#CONFIG_STD_CPP11=y
#CONFIG_NEWLIB_LIBC=y
#CONFIG_LIB_CPLUSPLUS=y

#CONFIG_DEBUG=n
CONFIG_DEBUG_OPTIMIZATIONS=n
#CONFIG_SIZE_OPTIMIZATIONS=y
#CONFIG_SPEED_OPTIMIZATIONS=y

# These KConfigs will dump the entire core into the logs. Useful for debugging a crash.
#CONFIG_DEBUG_COREDUMP=y
#CONFIG_DEBUG_COREDUMP_BACKEND_LOGGING=y
CONFIG_DEBUG_INFO=y
CONFIG_RESET_ON_FATAL_ERROR=y

#Log config
CONFIG_LOG=y
CONFIG_LOG_DEFAULT_LEVEL=2
# LOG_MODE_MIMIMAL Processes logs in the thread that they are in.
CONFIG_LOG_MODE_MINIMAL=n
#CONFIG_LOG_MODE_DEFERRED=n
#CONFIG_LOG_MODE_IMMEDIATE=n
# this makes prink messages go through the LOG system.
CONFIG_LOG_PRINTK=y
# typically logging is seperate from printk, so this just let's printk output go to console.
CONFIG_PRINTK=y
CONFIG_LOG_MAX_LEVEL=4
# Additional Logging Settings
# this makes the logs have color according to their condition in the serial monitor or terminal.
# so, errors are red, and warnings are yellow.
CONFIG_LOG_BACKEND_SHOW_COLOR=n
# if we using the deffered log proessing, we have these options avalible:
# LOG_MODE_DEFFERED auto turns this on. deffered mode makes the logs go to a seperate thread instead, which we currently use.
CONFIG_LOG_PROCESS_THREAD=y
#CONFIG_LOG_PROCESS_THREAD_CUSTOM_PRIORITY=
# we need this since our usb takes a few seconds to initialize, and so we miss messages if we don't do a late log startup.
CONFIG_LOG_PROCESS_THREAD_STARTUP_DELAY_MS=8000
#CONFIG_LOG_PROCESS_TRIGGER_THRESHOLD=0
# THREAD_SLEEP_MS is how long the logging thread will periodically sleep after processing messages. 
CONFIG_LOG_PROCESS_THREAD_SLEEP_MS=4000
CONFIG_LOG_PROCESS_THREAD_STACK_SIZE=4096
# Reserve 16 KiB for logging and 2 KiB each for USB CDC RX and TX.
CONFIG_LOG_BUFFER_SIZE=16384
CONFIG_USB_CDC_ACM_RINGBUF_SIZE=2048
CONFIG_SEGGER_RTT_BUFFER_SIZE_UP=4096

# USB is disabled while ECG collection is active so the NAND disk is not
# exposed to the host while firmware is writing data.
CONFIG_USB_ALWAYS_ON=y

CONFIG_NRFX_RTC0=y
CONFIG_NRFX_GPIOTE0=y
CONFIG_NRFX_DPPI0=y

# The thread analyser is a cool logging tool that shows how full stacks are for running threads. It can be used to detect stack overflow errors.
CONFIG_THREAD_ANALYZER=y
CONFIG_THREAD_ANALYZER_USE_LOG=y
CONFIG_THREAD_ANALYZER_AUTO=y
CONFIG_THREAD_ANALYZER_AUTO_INTERVAL=10
CONFIG_THREAD_NAME=y
CONFIG_THREAD_MONITOR=y

# when working with the MSense Devices, the only debugging tool we have is the SEGGER_RTT and USB debug output. 
# We have a USB, but we have to set it up via CDC UART (CDC is a usb communication protocol) on device tree
# at the moment, it appears Segger RTT is required even for UART Console output.
CONFIG_USE_SEGGER_RTT=y
# LOG_BACKEND makes the logging avalible, while the CONSOLE option makes command output
CONFIG_LOG_BACKEND_RTT=y
CONFIG_RTT_CONSOLE=n
# Shell also allows commands to be sent
CONFIG_SHELL=n

#Outputs log through usb
CONFIG_LOG_BACKEND_UART=y
# same here, UART_CONSOLE allows commands to be sent while LOG_BACKEND_UART allows log messages to go out.
CONFIG_UART_CONSOLE=y

#CONFIG_RAM_CONSOLE=n

# The custom NAND double-buffer backend below replaces Zephyr's standard
# filesystem backend; enabling both defines the same file-output callback.
CONFIG_LOG_BACKEND_FS=n
#CONFIG_LOG_BACKEND_FS_OUTPUT_CUSTOM=y

# Outputs log through Ble
CONFIG_LOG_BACKEND_BLE=n
CONFIG_MSENSE_SENSOR_STREAM=y
# Custom MSense File Uploading that uses the double buffer system (zephyrfilesystem.c) to output
CONFIG_LOG_BACKEND_FS_BUFFER=y

# Our MSense boards don't have a DCDC on them. This is necessary for the boards to function, or else they will brick!
#CONFIG_BOARD_ENABLE_DCDC_APP=n
#CONFIG_BOARD_ENABLE_DCDC_NET=n

# Oscillator capacitor and bypass configuration is physical-board ownership.
# boards/senselab/ecgv0 supplies the external-clock configuration to the
# application, MCUboot, and HCI IPC images through custom board defconfigs.


#Gpio Config
CONFIG_GPIO=y

# SPI Config
CONFIG_SPI=y
# we don't have any qspi periperals at the moment, everything is spi.
#CONFIG_NRFX_QSPI=y

#I2C config
CONFIG_I2C=y

# Generic Sensor Drivers that includes the battery monitor sensor.
CONFIG_SENSOR=y



# CMSIS config, which is a DSP and Math library
CONFIG_CMSIS_DSP=y
CONFIG_CMSIS_DSP_BASICMATH=y
CONFIG_CMSIS_DSP_COMPLEXMATH=n
CONFIG_CMSIS_DSP_CONTROLLER=n
CONFIG_CMSIS_DSP_DISTANCE=n
CONFIG_CMSIS_DSP_FASTMATH=y
CONFIG_CMSIS_DSP_FILTERING=y
CONFIG_CMSIS_DSP_MATRIX=y
CONFIG_CMSIS_DSP_STATISTICS=y
CONFIG_CMSIS_DSP_TRANSFORM=n
CONFIG_CMSIS_DSP_SUPPORT=y

# timer config
CONFIG_NRFX_TIMER0=y
CONFIG_NRFX_TIMER1=y

#FPU config
CONFIG_FPU=y
CONFIG_FP_HARDABI=y


# The board supplies its own gpio-leds and ECGv0 user-button nodes.



# Bluetooth host configuration
CONFIG_BT=y
# The board selects IPC transport between the application host and network-core
# controller; CONFIG_BT_HCI_IPC is not directly user-configurable.

#CONFIG_BT_BONDABLE=y
#CONFIG_BT_BONDING_REQUIRED=y


CONFIG_BT_DEVICE_APPEARANCE=833

CONFIG_BT_MAX_CONN=1



CONFIG_BT_PERIPHERAL=y
# Zephyr enables peripheral preferred-parameter support by default. These
# values specify the connection parameters requested from the central.
CONFIG_BT_GAP_PERIPHERAL_PREF_PARAMS=y
CONFIG_BT_GAP_AUTO_UPDATE_CONN_PARAMS=y
CONFIG_BT_PERIPHERAL_PREF_MAX_INT=48
CONFIG_BT_PERIPHERAL_PREF_MIN_INT=24
CONFIG_BT_PERIPHERAL_PREF_LATENCY=3
# Units are 10 ms: 800 = 8 s, compliant with current Apple 6-18 s guidance (ADG section 55.6).
CONFIG_BT_PERIPHERAL_PREF_TIMEOUT=800
CONFIG_BT_DEVICE_NAME="MSense4ECG-"
CONFIG_BT_DEVICE_NAME_DYNAMIC=y
CONFIG_BT_DEVICE_NAME_MAX=16
CONFIG_BT_DEVICE_NAME_GATT_WRITABLE=n
CONFIG_HWINFO=y



# The Bluetooth controller runs in the network-core hci_ipc image. Configure
# its settings, including TX power, in child_image/hci_ipc.conf.

# Permit and automatically initiate PHY and data-length negotiation when a
# connection is established.
CONFIG_BT_PHY_UPDATE=y
CONFIG_BT_AUTO_PHY_UPDATE=y
CONFIG_BT_DATA_LEN_UPDATE=y
CONFIG_BT_AUTO_DATA_LEN_UPDATE=y

# for now, we don't use security, but we can re-enable if we want it.
CONFIG_BT_SMP=n

# Enable device information service for bluetooth
CONFIG_BT_DIS=y
CONFIG_BT_DIS_MANUF="SenseLab"
CONFIG_BT_DIS_PNP=n
CONFIG_BT_DIS_MODEL="5.0.2 NAND"
CONFIG_BT_DIS_SETTINGS=n

# Enable Battery service settings
CONFIG_BT_BAS=y



 

# I belive we do this because the flash reset function has a lot of stack usage.
CONFIG_BT_RX_STACK_SIZE=4096



#DFU/FOTA settings
CONFIG_BOOTLOADER_MCUBOOT=y

CONFIG_NCS_SAMPLE_MCUMGR_BT_OTA_DFU=y
#CONFIG_MCUBOOT_GENERATE_CONFIRMED_IMAGE=y


#CONFIG_MCUMGR_LOG_LEVEL_DBG=n
#CONFIG_MCUMGR_SMP_BT_AUTHEN=n

# For saving settings of bluetooth and other variables, turned off as there are currently issues getting it to work
#CONFIG_BT_SETTINGS=y
#CONFIG_SETTINGS_RUNTIME=y
#CONFIG_SETTINGS_NVS=y
#CONFIG_NVS=y

#CONFIG_SETTINGS_NONE=y

# not sure what this is
#CONFIG_MPU_ALLOW_FLASH_WRITE=y



CONFIG_TEST_RANDOM_GENERATOR=y
CONFIG_TIMER_RANDOM_GENERATOR=y


# Flash Driver Config
CONFIG_SPI_NOR=y
CONFIG_FLASH=y
# QSPI Driver for QSPI Nor Flash. No longer used as we use NAND for storage.
CONFIG_NORDIC_QSPI_NOR=n
CONFIG_FLASH_MAP=y
CONFIG_FLASH_PAGE_LAYOUT=y
CONFIG_FLASH_LOG_LEVEL_INF=y
#CONFIG_SPI_NOR_FLASH_LAYOUT_PAGE_SIZE=4096

# Partition Manager Config

# Disk Driver Config
CONFIG_DISK_DRIVER_RAW_NAND=y
CONFIG_DISK_DRIVER_DHARA=n

CONFIG_RAW_NAND_BAD_SECTOR_SAVING=n

# File System Config
CONFIG_FILE_SYSTEM=y
CONFIG_CRC=y
# needed because of our BT DFU external flash image which forces us to use partition manager.
CONFIG_PM_OVERRIDE_EXTERNAL_DRIVER_CHECK=y
CONFIG_MASS_STORAGE_DISK_NAME="SD"
#CONFIG_FILE_SYSTEM_LITTLEFS=y
# ELM Chan's fat filesystem library
CONFIG_FAT_FILESYSTEM_ELM=y
# we implement this dynamically by remounting the file system as read only.
CONFIG_FS_FATFS_READ_ONLY=n
# below config is necessary because this determines the buffer fatfs internally uses to store reads which we do at a size of 4096
CONFIG_FS_FATFS_MAX_SS=4096
CONFIG_FS_FATFS_EXFAT=n
CONFIG_FS_FATFS_MAX_ROOT_ENTRIES=4096
CONFIG_FS_FATFS_LFN=y

# we no longer use little fs since there is no built in computer file system support on USB mass.
#CONFIG_FS_LITTLEFS_CACHE_SIZE=128
#CONFIG_FS_LITTLEFS_READ_SIZE=16
#CONFIG_FS_LITTLEFS_PROG_SIZE=16




#USB related configs
CONFIG_USB_DEVICE_STACK=y
CONFIG_USB_DEVICE_PRODUCT="MSense4 USB Mass"
CONFIG_USB_DEVICE_PID=0x0008
CONFIG_USB_MASS_STORAGE=y
CONFIG_SERIAL=y

CONFIG_USB_MAX_POWER=100
# Keep USB control-transfer chatter out of normal operation logs.
CONFIG_USB_DEVICE_LOG_LEVEL_ERR=y
CONFIG_USB_MASS_STORAGE_LOG_LEVEL_INF=y

CONFIG_USB_DEVICE_INITIALIZE_AT_BOOT=n
CONFIG_MASS_STORAGE_STACK_SIZE=4096


# Previous method of data gathering, where data from sensors is sent through bluetooth instead of the file system.
CONFIG_MSENSE_USB_SECURITY=n

# ICM-20948 accelerometer and MAX30001 ECG logs
CONFIG_LOG_LEVEL_ICM20948_ACCEL=3
CONFIG_LOG_LEVEL_MAX30001=3


# General System Memory and stack Configs
CONFIG_SYSTEM_WORKQUEUE_STACK_SIZE=20192
CONFIG_SYSTEM_WORKQUEUE_PRIORITY=-5
#CONFIG_SYSTEM_WORKQUEUE_NO_YIELD=y

CONFIG_HEAP_MEM_POOL_SIZE=5384
CONFIG_MAIN_STACK_SIZE=20192
```

## src/BLEService.h
```c
#ifndef BLESERVICE_H_
#define BLESERVICE_H_
#include <zephyr/types.h>
#include <sys/types.h>
#include <zephyr/bluetooth/bluetooth.h>


extern bool connectedFlag;
extern bool collecting_data;
extern bool host_wants_collection;
extern bool battery_low;
extern bool file_system_full;
extern bool file_system_malfunction;
extern bool battery_charging;



// Main Service UUID 
#define CONTROL_SERVICE_UUID  0x1F, 0x35, 0xBD, 0x4B, 0xAE, 0xD0, 0x68, 0x9C, \
  0xE2, 0x48, 0x81, 0x1D, 0x30, 0xC9, 0x39, 0xDA    

#define WRITE_ENABLE_CHARACTERISTIC_UUID 0x1F, 0x35, 0xBD, 0x4B, 0xAE, 0xD0, 0x68, 0x9C, \
  0xE2, 0x48, 0x81, 0x1D, 0x31, 0xC9, 0x39, 0xDA

#define WRITE_DATE_CHARACTERISTIC_UUID 0x1F, 0x35, 0xBD, 0x4B, 0xAE, 0xD0, 0x68, 0x9C, \
  0xE2, 0x48, 0x81, 0x1D, 0x32, 0xC9, 0x39, 0xDA

#define WRITE_PATIENT_CHARACTERISTIC_UUID 0x1F, 0x35, 0xBD, 0x4B, 0xAE, 0xD0, 0x68, 0x9C, \
  0xE2, 0x48, 0x81, 0x1D, 0x33, 0xC9, 0x39, 0xDA

#define WRITE_RESET_CHARACTERISTIC_UUID 0x1F, 0x35, 0xBD, 0x4B, 0xAE, 0xD0, 0x68, 0x9C, \
  0xE2, 0x48, 0x81, 0x1D, 0x34, 0xC9, 0x39, 0xDA

/* Legacy UUID retained for active ECG manual test-file commands 130 and 150. */
#define WRITE_DEVICE_NAME_CHARACTERISTIC_UUID 0x1F, 0x35, 0xBD, 0x4B, 0xAE, 0xD0, 0x68, 0x9C, \
  0xE2, 0x48, 0x81, 0x1D, 0x35, 0xC9, 0x39, 0xDA

#define STATUS_SERVICE_UUID 0x1F, 0x35, 0xBD, 0x4B, 0xAE, 0xD0, 0x68, 0x9C, \
  0xE2, 0x48, 0x81, 0x1D, 0x40, 0xC9, 0x39, 0xDA

#define READ_STORAGE_LEFT_UUID 0x1F, 0x35, 0xBD, 0x4B, 0xAE, 0xD0, 0x68, 0x9C, \
  0xE2, 0x48, 0x81, 0x1D, 0x41, 0xC9, 0x39, 0xDA

#define READ_STATUS_REGISTER_UUID 0x1F, 0x35, 0xBD, 0x4B, 0xAE, 0xD0, 0x68, 0x9C, \
  0xE2, 0x48, 0x81, 0x1D, 0x42, 0xC9, 0x39, 0xDA

#define READ_UPTIME_UUID 0x1F, 0x35, 0xBD, 0x4B, 0xAE, 0xD0, 0x68, 0x9C, \
  0xE2, 0x48, 0x81, 0x1D, 0x43, 0xC9, 0x39, 0xDA

/* Legacy motion-update UUIDs retained for client compatibility. */
#define TIMING_UPDATE_SERVICE_UUID 0x1F, 0x35, 0xBD, 0x4B, 0xAE, 0xD0, 0x68, 0x9C, \
  0xE2, 0x48, 0x81, 0x1D, 0x50, 0xC9, 0x39, 0xDA

#define TIMING_UPDATE_CHARACTERISTIC_UUID 0x1F, 0x35, 0xBD, 0x4B, 0xAE, 0xD0, 0x68, 0x9C, \
  0xE2, 0x48, 0x81, 0x1D, 0x51, 0xC9, 0x39, 0xDA

void connected(struct bt_conn *conn, uint8_t err);
void disconnected(struct bt_conn *conn, uint8_t reason);





int general_ble_notification(uint8_t* data, uint8_t len, int service, int characteristic);
void status_reg_ble_notification();

int storage_ble_notification(uint8_t* data, uint8_t len);

/**
 * @brief Start the boot-relative RTC0 counter at 512 Hz.
 *
 * The first call clears the counter at boot; later calls are idempotent.
 */
int rtc0_collection_counter_start(void);

/**
 * @brief Stop collection timing notifications while retaining the RTC0 counter.
 */
void rtc0_collection_counter_stop(void);

/**
 * @brief Read the active 32-bit wrap-extended RTC0 counter in 512 Hz ticks.
 *
 * The 24-bit hardware counter is extended in software and wraps naturally
 * after 2^32 ticks. Callers must provide a non-NULL output pointer and must
 * tolerate -EACCES before the boot-time counter initialization succeeds.
 */
int rtc0_collection_counter_get(uint32_t *ticks);

/**
 * @brief Start 3-second BLE timing notifications from the RTC0 compare event.
 *
 * This must be called after the 512 Hz collection counter is running.
 */
int rtc0_collection_notification_start(void);


/* These APIs only signal the authoritative ECG transition owner in main.c. */
void request_ecg_collection_mode(bool enable);
int request_ecg_storage_reboot(void);
int request_ecg_storage_reset(bool reset_bad_blocks);
int request_ecg_manual_test_file(uint8_t command);
void request_ecg_storage_fault(void);
void ecg_filesystem_log_enable(void);
void ecg_filesystem_log_disable(void);
void ecg_filesystem_log_disable_and_wait(void);
void reset_device(bool reset_bad_blocks);

#endif
```

## src/accelRecorder.c
```c
#include "accelRecorder.h"
#include "accelRecordFormat.h"
#include "accelTimingEstimator.h"
#include "imuFsyncTiming.h"
#include "zephyrfilesystem.h"

#include <errno.h>
#include <stdbool.h>
#include <stdint.h>

#include <zephyr/fs/fs.h>
#include <zephyr/kernel.h>
#include <zephyr/logging/log.h>
#include <zephyr/spinlock.h>
#include <zephyr/sys/atomic.h>
#include <zephyr/sys/util.h>

LOG_MODULE_REGISTER(accel_recorder, CONFIG_LOG_LEVEL_ICM20948_ACCEL);

#define ACCEL_RECORD_BUFFER_COUNT 4U
#define ACCEL_RECORD_SYNC_INTERVAL_BLOCKS 8U
#define ACCEL_RECORD_PATH_MAX 96U

BUILD_ASSERT(ACCEL_RECORD_FORMAT_FILE_BYTES == RECORDING_FILE_BYTES,
	     "Accelerometer and ECG chunk sizes must match");
BUILD_ASSERT(ACCEL_RECORD_FORMAT_BLOCK_BYTES <= FILESYSTEM_SCRATCH_BYTES,
	     "Filesystem scratch page must hold accelerometer metadata");

enum accel_record_block_state {
	ACCEL_RECORD_BLOCK_FREE,
	ACCEL_RECORD_BLOCK_FILLING,
	ACCEL_RECORD_BLOCK_PENDING,
	ACCEL_RECORD_BLOCK_QUEUED,
	ACCEL_RECORD_BLOCK_WRITING,
};

enum accel_record_control_operation {
	ACCEL_RECORD_CONTROL_NONE,
	ACCEL_RECORD_CONTROL_OPEN,
	ACCEL_RECORD_CONTROL_ROTATE,
	ACCEL_RECORD_CONTROL_CLOSE,
	ACCEL_RECORD_CONTROL_ABORT,
};

struct accel_record_block {
	struct k_work work;
	uint8_t data[ACCEL_RECORD_FORMAT_BLOCK_BYTES];
	atomic_t state;
	size_t sample_count;
	size_t write_length;
	uint64_t first_sample_sequence;
	uint32_t reserved_timer_output;
	uint32_t pending_order;
	bool sync_after_write;
};

static struct accel_record_block accel_record_blocks[ACCEL_RECORD_BUFFER_COUNT] __aligned(4);
static struct fs_file_t accel_record_file;
static struct k_work accel_record_control_work;
static struct k_work accel_record_prepare_work;
static struct k_sem accel_record_control_done;
static struct k_spinlock accel_record_state_lock;
static atomic_t accel_record_active;
static atomic_t accel_record_failed;
static atomic_t accel_record_rotating;
static atomic_t accel_record_rotation_completion_pending;
static bool accel_record_initialized;
static bool accel_record_file_open;
static bool accel_record_file_retired;
static bool accel_record_retired_handle_live;
static bool accel_record_next_prepared;
static bool accel_record_chunk_full;
static uint32_t accel_record_session_full_block_count;
static uint32_t accel_record_chunk_full_block_count;
static uint32_t accel_record_chunk_data_bytes;
static uint32_t accel_record_chunk_index;
static uint64_t accel_record_session_id;
static uint64_t accel_record_next_sample_sequence;
static uint32_t accel_record_dropped_samples;
static uint32_t accel_record_pending_order;
static struct accel_record_block *accel_record_filling_block;
static enum accel_record_control_operation accel_record_control_operation;
static int accel_record_control_result;
static char accel_record_path[ACCEL_RECORD_PATH_MAX];
static char accel_record_next_path[ACCEL_RECORD_PATH_MAX];
static accel_recorder_fault_handler_t accel_record_fault_handler;
static void *accel_record_fault_context;
static struct accel_timing_estimator accel_record_timing_estimator;
static bool accel_record_marker_valid;
static uint8_t accel_record_previous_marker;

static void accel_record_report_fault(int error)
{
	if (atomic_cas(&accel_record_failed, 0, 1)) {
		atomic_clear(&accel_record_active);
		LOG_ERR("Accelerometer recording failed: %d", error);
		if (accel_record_fault_handler != NULL) {
			accel_record_fault_handler(accel_record_fault_context);
		}
	}
}

static int accel_record_finalize_block(struct accel_record_block *block)
{
	uint32_t estimated_ticks;
	int ret;

	ret = accel_timing_estimator_estimate(&accel_record_timing_estimator,
					      block->first_sample_sequence,
					      &estimated_ticks, NULL);
	if (ret != 0) {
		return ret;
	}

	block->reserved_timer_output = estimated_ticks;

	block->write_length = accel_record_format_finalize_block(
		block->data, block->sample_count,
		(uint32_t)block->first_sample_sequence,
		block->reserved_timer_output);
	if (block->sample_count == ACCEL_RECORD_FORMAT_SAMPLES_PER_BLOCK) {
		accel_record_session_full_block_count++;
	}

	return 0;
}

static struct accel_record_block *accel_record_take_free_block(void)
{
	for (size_t i = 0U; i < ARRAY_SIZE(accel_record_blocks); i++) {
		if (atomic_cas(&accel_record_blocks[i].state,
			       ACCEL_RECORD_BLOCK_FREE,
			       ACCEL_RECORD_BLOCK_FILLING)) {
			accel_record_blocks[i].sample_count = 0U;
			accel_record_blocks[i].write_length = 0U;
			accel_record_blocks[i].first_sample_sequence = 0U;
			accel_record_blocks[i].reserved_timer_output = 0U;
			accel_record_blocks[i].pending_order = 0U;
			accel_record_blocks[i].sync_after_write = false;
			return &accel_record_blocks[i];
		}
	}

	return NULL;
}

static void accel_record_release_block(struct accel_record_block *block)
{
	if (block != NULL) {
		atomic_set(&block->state, ACCEL_RECORD_BLOCK_FREE);
	}
}

static int accel_record_queue_block(struct accel_record_block *block)
{
	int ret;

	atomic_set(&block->state, ACCEL_RECORD_BLOCK_QUEUED);
	ret = k_work_submit_to_queue(&my_work_q, &block->work);
	if (ret != 1) {
		accel_record_release_block(block);
		return (ret < 0) ? ret : -EALREADY;
	}

	return 0;
}

static int accel_record_consume_fsync_marker(uint8_t marker,
					       uint64_t sample_sequence)
{
	struct imu_fsync_edge edge;
	int ret;

	if (!accel_record_marker_valid) {
		/* The timing generator holds FSYNC low until after FIFO streaming starts. */
		if (marker != 0U) {
			return -EIO;
		}
		accel_record_previous_marker = marker;
		accel_record_marker_valid = true;
		return 0;
	}

	if (marker == accel_record_previous_marker) {
		return 0;
	}

	ret = imu_fsync_timing_take_edge(&edge);
	if (ret != 0) {
		return ret;
	}
	if (edge.level != marker) {
		return -EIO;
	}

	ret = accel_timing_estimator_observe(&accel_record_timing_estimator,
		&(struct accel_timing_observation){
			.sample_sequence = sample_sequence,
			.rtc_ticks = edge.rtc_ticks,
		});
	if (ret != 0) {
		return ret;
	}

	accel_record_previous_marker = marker;
	return 0;
}

static int accel_record_queue_current_chunk_block(struct accel_record_block *block)
{
	int ret;

	if ((accel_record_chunk_data_bytes + block->write_length) >
	    ACCEL_RECORD_FORMAT_DATA_BYTES) {
		return -ENOSPC;
	}

	accel_record_chunk_data_bytes += (uint32_t)block->write_length;
	if (block->write_length == ACCEL_RECORD_FORMAT_BLOCK_BYTES) {
		accel_record_chunk_full_block_count++;
	}

	ret = accel_record_queue_block(block);
	if (ret != 0) {
		return ret;
	}

	if (accel_record_chunk_full_block_count ==
	    ACCEL_RECORD_FORMAT_FULL_BLOCKS_PER_FILE) {
		accel_record_chunk_full = true;
	}

	return 0;
}

static int accel_record_write_trailer(uint8_t *metadata)
{
	ssize_t written;
	int ret;

	if (accel_record_file_retired) {
		return -EIO;
	}
	accel_record_format_build_trailer(metadata,
					  accel_record_chunk_data_bytes);
	ret = fs_seek(&accel_record_file, ACCEL_RECORD_FORMAT_TRAILER_OFFSET,
		      FS_SEEK_SET);
	if (ret != 0) {
		accel_record_file_retired = true;
		accel_record_retired_handle_live = true;
		accel_record_file_open = false;
		return ret;
	}

	written = fs_write(&accel_record_file, metadata,
			   ACCEL_RECORD_FORMAT_TRAILER_BYTES);
	if (written != (ssize_t)ACCEL_RECORD_FORMAT_TRAILER_BYTES) {
		accel_record_file_retired = true;
		accel_record_retired_handle_live = true;
		accel_record_file_open = false;
		return (written < 0) ? (int)written : -EIO;
	}

	return 0;
}

static int accel_record_close_current_chunk(void)
{
	int ret = 0;
	int close_ret;

	if (!accel_record_file_open || accel_record_file_retired) {
		return accel_record_file_retired ? -EIO : 0;
	}

	ret = accel_record_write_trailer(filesystem_scratch_buffer());
	if (ret != 0) {
		return ret;
	}
	close_ret = fs_close(&accel_record_file);
	fs_file_t_init(&accel_record_file);
	accel_record_file_open = false;
	if (close_ret != 0) {
		accel_record_file_retired = true;
		accel_record_retired_handle_live = false;
		return close_ret;
	}
	return 0;
}

static int accel_record_open_current_chunk(void)
{
	uint8_t *metadata = filesystem_scratch_buffer();
	int ret;

	if (accel_record_file_retired) {
		return -EIO;
	}
	ret = filesystem_make_recording_chunk_path(
		accel_record_path, sizeof(accel_record_path), "ac",
		accel_record_session_id, accel_record_chunk_index);
	if (ret != 0) {
		return ret;
	}

	accel_record_format_build_header(metadata);
	ret = filesystem_preallocate_file(
		&accel_record_file, accel_record_path,
		ACCEL_RECORD_FORMAT_FILE_BYTES, metadata,
		ACCEL_RECORD_FORMAT_BLOCK_BYTES, true);
	if (ret != 0) {
		return ret;
	}
	accel_record_file_open = true;
	LOG_INF("Accelerometer recording to %s", accel_record_path);
	return 0;
}

static int accel_record_prepare_next_chunk(void)
{
	struct fs_file_t file;
	uint32_t next_index = accel_record_chunk_index + 1U;
	int ret;

	if (accel_record_file_retired) {
		return -EIO;
	}
	ret = filesystem_make_recording_chunk_path(
		accel_record_next_path, sizeof(accel_record_next_path), "ac",
		accel_record_session_id, next_index);
	if (ret != 0) {
		return ret;
	}
	ret = filesystem_preallocate_file(
		&file, accel_record_next_path, ACCEL_RECORD_FORMAT_FILE_BYTES,
		NULL, 0U, false);
	if (ret == 0) {
		accel_record_next_prepared = true;
	}
	return ret;
}

static int accel_record_activate_next_chunk(void)
{
	uint8_t *metadata = filesystem_scratch_buffer();
	ssize_t written;
	int ret;

	if (accel_record_file_retired || !accel_record_next_prepared) {
		return -ENOSPC;
	}
	ret = accel_record_close_current_chunk();
	if (ret != 0) {
		return ret;
	}
	accel_record_chunk_index++;
	accel_record_chunk_full_block_count = 0U;
	accel_record_chunk_data_bytes = 0U;
	accel_record_chunk_full = false;
	ret = filesystem_open_preallocated_file(
		&accel_record_file, accel_record_next_path, 0U);
	if (ret != 0) {
		return ret;
	}
	accel_record_file_open = true;
	strcpy(accel_record_path, accel_record_next_path);
	accel_record_next_prepared = false;
	accel_record_format_build_header(metadata);
	written = fs_write(&accel_record_file, metadata,
			   ACCEL_RECORD_FORMAT_BLOCK_BYTES);
	if (written != (ssize_t)ACCEL_RECORD_FORMAT_BLOCK_BYTES) {
		return written < 0 ? (int)written : -EIO;
	}
	return fs_sync(&accel_record_file);
}

static void accel_record_prepare_work_handler(struct k_work *work)
{
	int ret;

	ARG_UNUSED(work);
	if (!accel_record_file_open || accel_record_file_retired || accel_record_next_prepared ||
	    atomic_get(&accel_record_failed) != 0) {
		return;
	}
	ret = accel_record_prepare_next_chunk();
	if (ret != 0) {
		accel_record_report_fault(ret);
	}
}

static void accel_record_block_work_handler(struct k_work *work)
{
	struct accel_record_block *block =
		CONTAINER_OF(work, struct accel_record_block, work);
	ssize_t written;
	int ret = 0;

	atomic_set(&block->state, ACCEL_RECORD_BLOCK_WRITING);
	if (accel_record_file_retired) {
		ret = -EIO;
	} else {
		written = fs_write(&accel_record_file, block->data, block->write_length);
		if (written != (ssize_t)block->write_length) {
			ret = (written < 0) ? (int)written : -EIO;
			accel_record_file_retired = true;
			accel_record_retired_handle_live = true;
			accel_record_file_open = false;
		} else if (block->sync_after_write) {
			ret = fs_sync(&accel_record_file);
		}
	}

	if (ret != 0) {
		accel_record_report_fault(ret);
	}

	accel_record_release_block(block);
}

static int accel_record_dispatch_pending_blocks(void)
{
	int ret = 0;

	for (;;) {
		struct accel_record_block *next = NULL;

		for (size_t i = 0U; i < ARRAY_SIZE(accel_record_blocks); i++) {
			struct accel_record_block *block = &accel_record_blocks[i];

			if (atomic_get(&block->state) !=
			    ACCEL_RECORD_BLOCK_PENDING) {
				continue;
			}
			if ((next == NULL) ||
			    (block->pending_order < next->pending_order)) {
				next = block;
			}
		}

		if (next == NULL) {
			return 0;
		}

		ret = accel_record_queue_current_chunk_block(next);
		if (ret != 0) {
			return ret;
		}
	}

	return 0;
}

static void accel_record_control_work_handler(struct k_work *work)
{
	enum accel_record_control_operation operation =
		accel_record_control_operation;
	int ret = 0;

	ARG_UNUSED(work);

	switch (operation) {
	case ACCEL_RECORD_CONTROL_OPEN:
		ret = accel_record_open_current_chunk();
		if (ret == 0) {
			ret = accel_record_prepare_next_chunk();
		}
		if (ret != 0 && accel_record_file_open) {
			(void)fs_close(&accel_record_file);
			accel_record_file_open = false;
		}
		break;

	case ACCEL_RECORD_CONTROL_ROTATE:
		ret = accel_record_activate_next_chunk();
		{
			k_spinlock_key_t key =
				k_spin_lock(&accel_record_state_lock);

			if (ret == 0) {
				ret = accel_record_dispatch_pending_blocks();
			}
			atomic_clear(&accel_record_rotating);
			k_spin_unlock(&accel_record_state_lock, key);
		}

		if (ret == 0) {
			ret = k_work_submit_to_queue(&my_work_q,
						  &accel_record_prepare_work);
			if (ret >= 0) {
				ret = 0;
			}
		}
		break;

	case ACCEL_RECORD_CONTROL_CLOSE:
		ret = accel_record_close_current_chunk();
		break;

	case ACCEL_RECORD_CONTROL_ABORT:
		if (accel_record_file_open) {
			ret = fs_close(&accel_record_file);
			accel_record_file_open = false;
		}
		break;

	case ACCEL_RECORD_CONTROL_NONE:
	default:
		ret = -EINVAL;
		break;
	}
	if ((operation == ACCEL_RECORD_CONTROL_CLOSE ||
	     operation == ACCEL_RECORD_CONTROL_ABORT) &&
	    accel_record_next_prepared) {
		int unlink_ret = fs_unlink(accel_record_next_path);

		if (unlink_ret != 0 && ret == 0) {
			ret = unlink_ret;
		}
		accel_record_next_prepared = false;
	}

	if (ret != 0) {
		accel_record_report_fault(ret);
	}
	accel_record_control_result = ret;
	k_sem_give(&accel_record_control_done);
}

static void accel_record_initialize(void)
{
	if (accel_record_initialized) {
		return;
	}

	for (size_t i = 0U; i < ARRAY_SIZE(accel_record_blocks); i++) {
		k_work_init(&accel_record_blocks[i].work,
			    accel_record_block_work_handler);
		atomic_set(&accel_record_blocks[i].state,
			   ACCEL_RECORD_BLOCK_FREE);
	}
	k_work_init(&accel_record_control_work, accel_record_control_work_handler);
	k_work_init(&accel_record_prepare_work, accel_record_prepare_work_handler);
	k_sem_init(&accel_record_control_done, 0, 1);
	accel_record_initialized = true;
}

static int accel_record_submit_control(
	enum accel_record_control_operation operation)
{
	int ret;

	k_sem_reset(&accel_record_control_done);
	accel_record_control_operation = operation;
	ret = k_work_submit_to_queue(&my_work_q, &accel_record_control_work);
	if (ret <= 0) {
		return (ret < 0) ? ret : -EALREADY;
	}

	ret = k_sem_take(&accel_record_control_done, K_FOREVER);
	if (ret != 0) {
		accel_record_report_fault(ret);
		return ret;
	}

	return accel_record_control_result;
}

static int accel_record_start_rotation(void)
{
	int ret;

	atomic_set(&accel_record_rotating, 1);
	atomic_set(&accel_record_rotation_completion_pending, 1);
	k_sem_reset(&accel_record_control_done);
	accel_record_control_operation = ACCEL_RECORD_CONTROL_ROTATE;
	ret = k_work_submit_to_queue(&my_work_q, &accel_record_control_work);
	if (ret <= 0) {
		atomic_clear(&accel_record_rotating);
		atomic_clear(&accel_record_rotation_completion_pending);
		return (ret < 0) ? ret : -EALREADY;
	}

	return 0;
}

static int accel_record_wait_for_rotation(void)
{
	int ret;

	if (atomic_get(&accel_record_rotation_completion_pending) == 0) {
		return 0;
	}

	ret = k_sem_take(&accel_record_control_done, K_FOREVER);
	if (ret != 0) {
		accel_record_report_fault(ret);
		return ret;
	}

	atomic_clear(&accel_record_rotation_completion_pending);
	return accel_record_control_result;
}

static void accel_record_release_pending_blocks(void)
{
	for (size_t i = 0U; i < ARRAY_SIZE(accel_record_blocks); i++) {
		if (atomic_get(&accel_record_blocks[i].state) ==
		    ACCEL_RECORD_BLOCK_PENDING) {
			accel_record_release_block(&accel_record_blocks[i]);
		}
	}
}

void accel_recorder_set_fault_handler(accel_recorder_fault_handler_t handler,
				      void *context)
{
	accel_record_fault_handler = handler;
	accel_record_fault_context = context;
}

int accel_recorder_start(uint64_t session_id)
{
	int ret;

	accel_record_initialize();
	if (!file_system_ready) {
		return -ENODEV;
	}
	if (atomic_get(&accel_record_active) != 0 ||
	    atomic_get(&accel_record_rotating) != 0 || accel_record_file_open ||
	    accel_record_next_prepared) {
		return -EALREADY;
	}
	if (accel_record_file_retired) {
		return -EIO;
	}

	atomic_clear(&accel_record_failed);
	atomic_clear(&accel_record_rotating);
	atomic_clear(&accel_record_rotation_completion_pending);
	accel_record_session_id = session_id;
	accel_record_chunk_index = 0U;
	accel_record_session_full_block_count = 0U;
	accel_record_chunk_full_block_count = 0U;
	accel_record_chunk_data_bytes = 0U;
	accel_record_chunk_full = false;
	accel_record_next_prepared = false;
	accel_record_pending_order = 0U;
	accel_record_next_sample_sequence = 0U;
	accel_record_dropped_samples = 0U;
	accel_record_filling_block = NULL;
	accel_timing_estimator_reset(&accel_record_timing_estimator);
	accel_record_marker_valid = false;
	accel_record_previous_marker = 0U;
	ret = accel_record_submit_control(ACCEL_RECORD_CONTROL_OPEN);
	if (ret != 0) {
		return ret;
	}

	accel_record_filling_block = accel_record_take_free_block();
	if (accel_record_filling_block == NULL) {
		(void)accel_recorder_abort();
		return -ENOMEM;
	}

	atomic_set(&accel_record_active, 1);
	return 0;
}

static int accel_record_take_next_filling_block(void)
{
	int ret;

	if (accel_record_filling_block != NULL) {
		return 0;
	}

	if (accel_record_chunk_full &&
	    (atomic_get(&accel_record_rotating) == 0)) {
		ret = accel_record_start_rotation();
		if (ret != 0) {
			return ret;
		}
	}

	accel_record_filling_block = accel_record_take_free_block();
	if (accel_record_filling_block == NULL) {
		return -ENOMEM;
	}

	return 0;
}

int accel_recorder_consume_fifo(const uint8_t *fifo_data, size_t fifo_bytes,
				void *context)
{
	ARG_UNUSED(context);

	if ((fifo_data == NULL) || (fifo_bytes == 0U) ||
	    ((fifo_bytes % ACCEL_RECORD_FORMAT_SAMPLE_BYTES) != 0U)) {
		accel_record_report_fault(-EINVAL);
		return -EINVAL;
	}
	if (atomic_get(&accel_record_active) == 0 ||
	    atomic_get(&accel_record_failed) != 0) {
		return -EIO;
	}

	for (size_t offset = 0U; offset < fifo_bytes;
	     offset += ACCEL_RECORD_FORMAT_SAMPLE_BYTES) {
		struct accel_record_block *block;
		uint8_t marker = fifo_data[offset + 1U] & 1U;
		int ret;

		ret = accel_record_consume_fsync_marker(
			marker, accel_record_next_sample_sequence);
		if (ret != 0) {
			accel_record_report_fault(ret);
			return ret;
		}
		ret = accel_record_take_next_filling_block();
		if (ret == -ENOMEM) {
			accel_record_next_sample_sequence++;
			accel_record_dropped_samples++;
			continue;
		}
		if (ret != 0) {
			accel_record_report_fault(ret);
			return ret;
		}
		block = accel_record_filling_block;

		if (block->sample_count == 0U) {
			block->first_sample_sequence = accel_record_next_sample_sequence;
		}

		accel_record_format_store_fifo_sample(block->data,
					      block->sample_count,
					      &fifo_data[offset]);
		block->sample_count++;
		accel_record_next_sample_sequence++;

		if (block->sample_count != ACCEL_RECORD_FORMAT_SAMPLES_PER_BLOCK) {
			continue;
		}

		ret = accel_record_finalize_block(block);
		if (ret != 0) {
			accel_record_report_fault(ret);
			return ret;
		}
		block->sync_after_write =
			((accel_record_session_full_block_count %
			  ACCEL_RECORD_SYNC_INTERVAL_BLOCKS) == 0U);
		accel_record_filling_block = NULL;

		if (atomic_get(&accel_record_rotating) != 0) {
			k_spinlock_key_t key =
				k_spin_lock(&accel_record_state_lock);

			if (atomic_get(&accel_record_rotating) != 0) {
				block->pending_order = accel_record_pending_order++;
				atomic_set(&block->state,
					   ACCEL_RECORD_BLOCK_PENDING);
				k_spin_unlock(&accel_record_state_lock, key);
				continue;
			}
			k_spin_unlock(&accel_record_state_lock, key);
		}

		ret = accel_record_queue_current_chunk_block(block);
		if (ret != 0) {
			accel_record_report_fault(ret);
			return ret;
		}
	}

	return 0;
}

int accel_recorder_stop(void)
{
	struct accel_record_block *block;
	int ret;

	if (!accel_record_initialized) {
		return 0;
	}

	atomic_clear(&accel_record_active);
	ret = accel_record_wait_for_rotation();
	if (ret != 0) {
		block = accel_record_filling_block;
		accel_record_filling_block = NULL;
		accel_record_release_block(block);
		accel_record_release_pending_blocks();
		if (accel_record_file_open || accel_record_next_prepared) {
			(void)accel_record_submit_control(ACCEL_RECORD_CONTROL_ABORT);
		}
		return ret;
	}
	if (accel_record_file_retired) {
		return -EIO;
	}
	if (!accel_record_file_open && !accel_record_next_prepared) {
		return 0;
	}
	if (!accel_record_file_open) {
		return accel_record_submit_control(ACCEL_RECORD_CONTROL_CLOSE);
	}

	block = accel_record_filling_block;
	accel_record_filling_block = NULL;
	if (block != NULL && block->sample_count != 0U) {
		ret = accel_record_finalize_block(block);
		if (ret != 0) {
			accel_record_release_block(block);
			accel_record_report_fault(ret);
			return ret;
		}
		/* The terminal short ACB1 block is sealed by trailer write + close. */
		block->sync_after_write = false;
		ret = accel_record_queue_current_chunk_block(block);
		if (ret != 0) {
			accel_record_report_fault(ret);
			return ret;
		}
	} else {
		accel_record_release_block(block);
	}

	ret = accel_record_submit_control(ACCEL_RECORD_CONTROL_CLOSE);
	if (ret == 0) {
		LOG_INF("Accelerometer recording stopped");
		if (accel_record_dropped_samples != 0U) {
			LOG_WRN("Accelerometer recording dropped %u samples from RAM pressure",
				(unsigned int)accel_record_dropped_samples);
		}
	}

	return ret;
}

int accel_recorder_abort(void)
{
	struct accel_record_block *block;
	int cleanup_ret;
	int ret;

	if (!accel_record_initialized) {
		return 0;
	}

	atomic_clear(&accel_record_active);
	ret = accel_record_wait_for_rotation();
	if (!accel_record_file_open && !accel_record_next_prepared) {
		return 0;
	}

	block = accel_record_filling_block;
	accel_record_filling_block = NULL;
	accel_record_release_block(block);
	accel_record_release_pending_blocks();
	cleanup_ret = accel_record_submit_control(ACCEL_RECORD_CONTROL_ABORT);
	return ret != 0 ? ret : cleanup_ret;
}

void accel_recorder_filesystem_unmounted(void)
{
	if (!accel_record_file_retired) {
		return;
	}
	if (accel_record_retired_handle_live) {
		/* FatFs is unmounted, so this releases its FIL slab without flushing data. */
		(void)fs_close(&accel_record_file);
	}
	fs_file_t_init(&accel_record_file);
	accel_record_file_retired = false;
	accel_record_retired_handle_live = false;
	accel_record_file_open = false;
	accel_record_next_prepared = false;
}
```

## src/accelRecorder.h
```c
#ifndef ACCEL_RECORDER_H_
#define ACCEL_RECORDER_H_

#include <stddef.h>
#include <stdint.h>

typedef void (*accel_recorder_fault_handler_t)(void *context);

int accel_recorder_start(uint64_t session_id);
int accel_recorder_consume_fifo(const uint8_t *fifo_data, size_t fifo_bytes,
				void *context);
int accel_recorder_stop(void);
int accel_recorder_abort(void);
void accel_recorder_filesystem_unmounted(void);
void accel_recorder_set_fault_handler(accel_recorder_fault_handler_t handler,
					  void *context);

#endif /* ACCEL_RECORDER_H_ */
```

## src/batterymonitordt.c
```c
/*
 * Copyright (c) 2025 The Ohio State University SENSE Lab
 *
 * SPDX-License-Identifier: Apache-2.0
 */

#include <zephyr/kernel.h>
#include <zephyr/device.h>
#include <zephyr/drivers/sensor.h>
#include <zephyr/sys/byteorder.h>
#include <zephyr/bluetooth/services/bas.h>
#include <zephyr/logging/log.h>
#include <hal/nrf_usbreg.h>
#include <zephyr/../../drivers/sensor/ti/bq274xx/bq274xx.h>
#include "batterymonitordt.h"
#include "BLEService.h"

LOG_MODULE_REGISTER(battery_monitor, LOG_LEVEL_INF);

int battery_level = 100;

/* Flags() bits used by the application. */
#define BQ27441_FLAG_ITPOR (1U << 8)

enum battery_power_flow {
	BATTERY_POWER_FLOW_UNKNOWN,
	BATTERY_POWER_FLOW_CHARGING,
	BATTERY_POWER_FLOW_DISCHARGING,
	BATTERY_POWER_FLOW_IDLE,
};

static bool gauge_reset_warning_reported;
static enum battery_power_flow last_power_flow = BATTERY_POWER_FLOW_UNKNOWN;
static bool vbus_state_known;
static bool last_vbus_present;

static void log_vbus_status(void)
{
	bool present = (nrf_usbreg_status_get(NRF_USBREGULATOR) &
		       NRF_USBREG_STATUS_VBUSDETECT_MASK) != 0U;

	if (!vbus_state_known || present != last_vbus_present) {
		LOG_INF("VBUS power input: %s", present ? "present" : "absent");
		last_vbus_present = present;
		vbus_state_known = true;
	}
}

static const char *battery_power_flow_name(enum battery_power_flow flow)
{
	switch (flow) {
	case BATTERY_POWER_FLOW_CHARGING:
		return "charging";
	case BATTERY_POWER_FLOW_DISCHARGING:
		return "discharging";
	case BATTERY_POWER_FLOW_IDLE:
		return "idle";
	default:
		return "unknown";
	}
}

/* Copied from the Zephyr BQ274xx driver because that helper has static scope. */
static int bq274xx_cmd_reg_read(const struct device *dev, uint8_t reg_addr,
						 int16_t *val)
{
	const struct bq274xx_config *config = dev->config;
	uint8_t i2c_data[2];
	int ret;

	ret = i2c_burst_read_dt(&config->i2c, reg_addr, i2c_data, sizeof(i2c_data));
	if (ret < 0) {
		LOG_ERR("Unable to read fuel-gauge register 0x%02x: %d", reg_addr, ret);
		return -EIO;
	}

	*val = sys_get_le16(i2c_data);
	return 0;
}

static int bq274xx_read_flags(const struct device *dev, uint16_t *flags)
{
	int16_t raw_flags;
	int ret;

	ret = bq274xx_cmd_reg_read(dev, BQ274XX_COMMAND_FLAGS, &raw_flags);
	if (ret < 0) {
		return ret;
	}

	*flags = (uint16_t)raw_flags;
	return 0;
}

static int bq274xx_read_channel(const struct device *dev, enum sensor_channel channel,
						struct sensor_value *value, const char *name)
{
	int ret;

	ret = sensor_sample_fetch_chan(dev, channel);
	if (ret < 0) {
		LOG_ERR("Unable to fetch %s: %d", name, ret);
		return ret;
	}

	ret = sensor_channel_get(dev, channel, value);
	if (ret < 0) {
		LOG_ERR("Unable to read %s: %d", name, ret);
	}

	return ret;
}

void dt_update_battery(const struct device *dev, bool log_summary)
{
	uint16_t flags_value;
	bool estimate_may_be_unreliable;
	bool current_battery_charging;
	int64_t average_current_ma;
	enum battery_power_flow current_power_flow;
	struct sensor_value voltage;
	struct sensor_value current;
	struct sensor_value state_of_charge;
	struct sensor_value avg_power;
	struct sensor_value full_charge_capacity;
	struct sensor_value remaining_charge_capacity;
	int status;

	/* Poll independently of fuel-gauge success, including when I2C fails. */
	log_vbus_status();

	/*
	 * sensor_sample_fetch_chan() retries bq274xx_gauge_configure() when the
	 * driver's previous configuration attempt failed. Do this before testing
	 * ITPOR so the periodic maintenance cycle can recover the gauge.
	 */
	if (bq274xx_read_channel(dev, SENSOR_CHAN_GAUGE_VOLTAGE, &voltage,
					"battery voltage") < 0) {
		return;
	}

	status = bq274xx_read_flags(dev, &flags_value);
	if (status < 0) {
		LOG_ERR("Unable to read fuel-gauge flags: %d", status);
		return;
	}

	/*
	 * A POR restores the gauge's RAM configuration from ROM. Continue to
	 * publish its readings while the configuration is incomplete, but identify
	 * them in the periodic log as potentially unreliable.
	 */
	estimate_may_be_unreliable = (flags_value & BQ27441_FLAG_ITPOR) != 0U;
	if (estimate_may_be_unreliable) {
		if (!gauge_reset_warning_reported) {
			LOG_WRN("Fuel gauge reset (Flags: 0x%04x); battery estimates may be unreliable until configured",
				flags_value);
			gauge_reset_warning_reported = true;
		}
	} else if (gauge_reset_warning_reported) {
		LOG_INF("Fuel-gauge configuration restored");
		gauge_reset_warning_reported = false;
	}

	if (bq274xx_read_channel(dev, SENSOR_CHAN_GAUGE_AVG_CURRENT, &current,
					"average current") < 0 ||
		bq274xx_read_channel(dev, SENSOR_CHAN_GAUGE_STATE_OF_CHARGE,
					&state_of_charge, "state of charge") < 0 ||
		bq274xx_read_channel(dev, SENSOR_CHAN_GAUGE_AVG_POWER, &avg_power,
					"average power") < 0) {
		return;
	}

	battery_level = state_of_charge.val1;
	bt_bas_set_battery_level(battery_level);

	/* The BQ27441 specifies positive AveragePower() as charging. */
	current_battery_charging = (avg_power.val1 > 0) ||
		(avg_power.val1 == 0 && avg_power.val2 > 0);
	if (current_battery_charging != battery_charging) {
		battery_charging = current_battery_charging;
		status_reg_ble_notification();
	}

	if (current_battery_charging) {
		current_power_flow = BATTERY_POWER_FLOW_CHARGING;
	} else if (avg_power.val1 < 0 ||
		   (avg_power.val1 == 0 && avg_power.val2 < 0)) {
		current_power_flow = BATTERY_POWER_FLOW_DISCHARGING;
	} else {
		current_power_flow = BATTERY_POWER_FLOW_IDLE;
	}

	/* Ignore idle samples and retain the last charging/discharging state. */
	if (current_power_flow != BATTERY_POWER_FLOW_IDLE &&
	    current_power_flow != last_power_flow) {
		LOG_INF("Battery power flow: %s",
			battery_power_flow_name(current_power_flow));
		last_power_flow = current_power_flow;
	}

	if (!log_summary) {
		return;
	}

	if (bq274xx_read_channel(dev, SENSOR_CHAN_GAUGE_FULL_CHARGE_CAPACITY,
					&full_charge_capacity, "full charge capacity") < 0 ||
		bq274xx_read_channel(dev, SENSOR_CHAN_GAUGE_REMAINING_CHARGE_CAPACITY,
					&remaining_charge_capacity, "remaining charge capacity") < 0) {
		return;
	}

	average_current_ma = sensor_value_to_milli(&current);
	if (estimate_may_be_unreliable) {
		LOG_WRN("Battery estimate may be unreliable (Flags: 0x%04x; configuration incomplete)",
			flags_value);
	}
	LOG_INF("Battery: %d.%03d V, SoC %d%%, %d mA, %s, %d mW; %d/%d mAh",
		voltage.val1, voltage.val2 / 1000, state_of_charge.val1,
		(int)average_current_ma, battery_power_flow_name(current_power_flow),
		avg_power.val1, remaining_charge_capacity.val1,
		full_charge_capacity.val1);
}
```

## src/ble_ppg_compat.c
```c
/*
 * ECGv0 retains these BLE-visible configuration values for compatibility with
 * its existing GATT contract. They do not initialize or access MAX86141
 * hardware; the PPG acquisition implementation remains unlinked from ECGv0.
 */

#include "ppgSensor.h"

struct ppg_configData ppgConfig = {
	.isEnabled = true,
	.sample_avg = PPG_FIXED_SAMPLE_AVG,
	.green_intensity = 0x30,
	.infraRed_intensity = 0x12,
	.sampling_time = 0x28,
	.numCounts = PPG_FIXED_NUM_COUNTS,
	.txPacketEnable = false,
};

bool use_fixed_ppg_brightness = false;
```

## src/ecgRecordFormat.h
```c
#ifndef ECG_RECORD_FORMAT_H
#define ECG_RECORD_FORMAT_H

#include "msense_ecg_block_format.h"

#endif /* ECG_RECORD_FORMAT_H */
```

## src/ecgRecorder.h
```c
#ifndef ECG_RECORDER_H
#define ECG_RECORDER_H

#include <stdbool.h>
#include <stdint.h>

typedef void (*ecg_recorder_fault_handler_t)(void *context);

int ecg_recorder_start(uint64_t session_id);
int ecg_recorder_stop(void);
bool ecg_recorder_shutdown_confirmed(void);
void ecg_recorder_set_fault_handler(ecg_recorder_fault_handler_t handler,
					     void *context);

#endif /* ECG_RECORDER_H */
```
