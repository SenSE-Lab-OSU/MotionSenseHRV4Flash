## ECGv0/tests/accel_record_format/testcase.yaml
```yaml
tests:
  app.accel_record_format:
    tags:
      - accel
      - filesystem
    platform_allow:
      - ecgv0/nrf5340/cpuapp
```

## ECGv0/tests/accel_recorder/testcase.yaml
```yaml
tests:
  app.accel_recorder:
    tags:
      - accel
      - filesystem
    platform_allow:
      - ecgv0/nrf5340/cpuapp
```

## ECGv0/tests/ecg_record_format/testcase.yaml
```yaml
tests:
  app.ecg_record_format:
    tags:
      - ecg
      - filesystem
    platform_allow:
      - native_sim
      - ecgv0/nrf5340/cpuapp
```

## MSenseDevice/src/drivers/Kconfig
```kconfig
# Copyright (c) 2022 Nordic Semiconductor ASA
# SPDX-License-Identifier: Apache-2.0

menuconfig QSPI_NOR_CUSTOM_DRIVER
	bool "custom sensor"
    default n
	select FLASH_HAS_DRIVER_ENABLED
	select NRFX_QSPI
	select FLASH_JESD21
	

menuconfig DISK_DRIVER_RAW_NAND
    bool
    prompt "NAND Disk for file storage with SENSE lab Simplified FTL. Allows buffered writing but does not support partial erases."
    default n


menuconfig RAW_NAND_BAD_BLOCK_SAVING
    bool
    prompt "Allows bad blocks to be registered in a memory array that is persisted across reboots."
    default n
    help
       Not currently enabled since our Custom Sense FTL does not support block reallocation.
       Pick where the table is kept with RAW_NAND_BAD_BLOCK_STORAGE below.
       See bad_block_detect_limit in bad_block.c for how large the table is.

if RAW_NAND_BAD_BLOCK_SAVING

choice RAW_NAND_BAD_BLOCK_STORAGE
    prompt "Where the bad block table is persisted"
    default RAW_NAND_BAD_BLOCK_STORAGE_NOR
    help
       The two backends are not interchangeable on a device that already has a
       table stored: switching re-runs the one time manufacturer bad block scan.

config RAW_NAND_BAD_BLOCK_STORAGE_NOR
    bool "External NOR flash, through the flash API"
    help
       Keeps the table in one sector of the external NOR just past the file table.
       Needs no extra partition, so the partition map stays identical to devices
       already in the field and they can still be updated over DFU. This is the
       original storage method.

config RAW_NAND_BAD_BLOCK_STORAGE_SETTINGS
    bool "Settings subsystem (NVS on internal flash)"
    select SETTINGS
    help
       Keeps the table in the settings subsystem. This requires Partition Manager
       to allocate a settings_storage partition, which changes the partition map:
       devices flashed with the older map cannot be updated to such a build over
       DFU. Prefer the NOR backend unless the internal flash is wanted for this.

endchoice

endif # RAW_NAND_BAD_BLOCK_SAVING

config RAW_NAND_ALLOW_RUNTIME_READONLY_FS
	bool "allows the file system to be set as read only during runtime (via set_read_only)"
	default n
	help
	   Dynamically allows the file system when using the NAND driver not allow any writes by calling the function set_read_only.
	    Note that this is a system that will only work at the internal software level: the drive is not actually readonly
		on windows, to do this, the drive must instead be mounted as readonly vs fs_mount. 

config BAD_BLOCK_SAVING_RUNTIME
    bool 
    prompt "Allows bad blocks to be registered in a memory array dynamically whenever the ECC flags it and not only during bad block detection"
    default n

menuconfig DISK_DRIVER_DHARA
    bool
    prompt "Disk Driver using dhara as the flash translation layer, instead of the SENSE lab custom nor solution."
    select BAD_BLOCK_SAVING_RUNTIME
    help
        uses Dhara's virtual addressing to handle bad blocks, wear leveling, and sector erasing
        for the current nand driver.

menuconfig SPI_NOR_CUSTOM_DRIVER
    bool
    prompt "Custom spi NOR driver, modified from spi_nor.c to be more generic and customizable."
    default n
```

## MSenseDevice/tests/accel_record_format/testcase.yaml
```yaml
tests:
  app.accel_record_format:
    tags:
      - accel
      - filesystem
    platform_allow:
      - nrf5340dk/nrf5340/cpuapp
```

## MSenseDevice/tests/ecg_record_format/testcase.yaml
```yaml
tests:
  app.ecg_record_format:
    tags:
      - ecg
      - filesystem
    platform_allow:
      - native_sim
      - nrf5340dk/nrf5340/cpuapp
```

## boards/senselab/bridge/Kconfig.bridge
```kconfig
config BOARD_BRIDGE
	select SOC_NRF5340_CPUAPP_QKAA if BOARD_BRIDGE_NRF5340_CPUAPP
	select SOC_NRF5340_CPUNET_QKAA if BOARD_BRIDGE_NRF5340_CPUNET
```

## boards/senselab/bridge/board.yml
```yaml
board:
  name: bridge
  full_name: SenseLab Bridge
  vendor: others
  socs:
    - name: nrf5340
```

## boards/senselab/ecgv0/Kconfig.ecgv0
```kconfig
config BOARD_ECGV0
	select SOC_NRF5340_CPUAPP_QKAA if BOARD_ECGV0_NRF5340_CPUAPP
	select SOC_NRF5340_CPUNET_QKAA if BOARD_ECGV0_NRF5340_CPUNET
```

## boards/senselab/ecgv0/board.yml
```yaml
board:
  name: ecgv0
  full_name: SenseLab ECGv0
  vendor: others
  socs:
    - name: nrf5340
```

## boards/senselab/ppgv2/Kconfig.defconfig
```kconfig
if BOARD_PPGV2_NRF5340_CPUAPP

# Workaround for Kconfig's comma-separated devicetree chosen property names.
DT_CHOSEN_Z_CODE_PARTITION := zephyr,code-partition
DT_CHOSEN_Z_SRAM_PARTITION := zephyr,sram-secure-partition

if TRUSTED_EXECUTION_SECURE

config FLASH_LOAD_SIZE
	default $(dt_chosen_reg_size_hex,$(DT_CHOSEN_Z_CODE_PARTITION))

config SRAM_SIZE
	default $(dt_chosen_reg_size_int,$(DT_CHOSEN_Z_SRAM_PARTITION),0,K)

endif

config BT_HCI_IPC
	default y if BT

config HEAP_MEM_POOL_ADD_SIZE_BOARD
	int
	default 4096 if BT_HCI_IPC

endif

if BOARD_PPGV2_NRF5340_CPUNET

config BT_CTLR
	default y if BT

endif
```

## boards/senselab/ppgv2/Kconfig.ppgv2
```kconfig
config BOARD_PPGV2
	select SOC_NRF5340_CPUAPP_QKAA if BOARD_PPGV2_NRF5340_CPUAPP
	select SOC_NRF5340_CPUNET_QKAA if BOARD_PPGV2_NRF5340_CPUNET
```

## boards/senselab/ppgv2/board.yml
```yaml
board:
  name: ppgv2
  full_name: SenseLab PPGv2
  vendor: others
  socs:
    - name: nrf5340
```

## dts/bindings/misc/senselab,bridge-control.yaml
```yaml
description: Bridge board control signals (no automatic initialization)
compatible: "senselab,bridge-control"
include: base.yaml
properties:
  power-mode-gpios:
    type: phandle-array
    description: TPS82693 MODE input, not a power enable
```

## dts/bindings/misc/senselab,bridge-fpga.yaml
```yaml
description: Bridge MachXO2 SPI endpoint and GPIO JTAG wiring; no driver yet
compatible: "senselab,bridge-fpga"
include: spi-device.yaml
properties:
  irq-gpios:
    type: phandle-array
  program-gpios:
    type: phandle-array
  done-gpios:
    type: phandle-array
  io-gpios:
    type: phandle-array
    description: Shared FPGA IO0 and IO1, keep as inputs until ownership is agreed
  tck-gpios:
    type: phandle-array
  tms-gpios:
    type: phandle-array
  tdi-gpios:
    type: phandle-array
  tdo-gpios:
    type: phandle-array
```

## dts/bindings/mtd/infineon,fm25cl64b.yaml
```yaml
description: FM25CL64B 8 KiB SPI FRAM wiring; no driver selected yet
compatible: "infineon,fm25cl64b"
include: spi-device.yaml
```

## dts/bindings/sensor/adi,adxl343.yaml
```yaml
description: Bridge ADXL343 I2C wiring; driver compatibility remains to be qualified
compatible: "adi,adxl343"
include: [sensor-device.yaml, i2c-device.yaml]
properties:
  int1-gpios:
    type: phandle-array
  int2-gpios:
    type: phandle-array
```

## shared/Kconfig
```kconfig
# Copyright (c) 2022 Nordic Semiconductor ASA
# SPDX-License-Identifier: Apache-2.0

menuconfig QSPI_NOR_CUSTOM_DRIVER
	bool "custom sensor"
	default n
	select FLASH_HAS_DRIVER_ENABLED
	select NRFX_QSPI
	select FLASH_JESD21

menuconfig DISK_DRIVER_RAW_NAND
	bool
	prompt "NAND Disk for file storage with SENSE lab Simplified FTL. Allows buffered writing but does not support partial erases."
	default n

menuconfig RAW_NAND_BAD_SECTOR_SAVING
	bool
	prompt "Allows bad pages to be dynamically registered in a memory array stored on the nor flash."
	default n
	help
	  Not currently enabled since our Custom Sense FTL does not support block reallocation.

config RAW_NAND_ALLOW_RUNTIME_READONLY_FS
	bool "allows the file system to be set as read only during runtime (via set_read_only)"
	default n
	help
	  Dynamically allows the file system when using the NAND driver not allow any writes by calling the function set_read_only.
	  Note that this is a system that will only work at the internal software level: the drive is not actually readonly
	  on windows, to do this, the drive must instead be mounted as readonly vs fs_mount.

menuconfig DISK_DRIVER_DHARA
	bool
	prompt "Disk Driver using dhara as the flash translation layer, instead of the SENSE lab custom nor solution."
	help
	  Not Currently Implemented, but uses Dhara's virtual addressing to handle bad blocks, wear leveling, and sector erasing
	  for the current nand driver.

menuconfig SPI_NOR_CUSTOM_DRIVER
	bool
	prompt "Custom spi NOR driver, modified from spi_nor.c to be more generic and customizable."
	default n

menuconfig MSENSE_SENSOR_STREAM
	bool "Bounded NUS sensor stream"
	depends on BT
	default n
	help
	  Provide the MotionSense version-0 sensor record stream over a
	  NUS-compatible GATT service. The application supplies recording lifecycle
	  events and mirrors finalized whole records from its single producer.

if MSENSE_SENSOR_STREAM

config MSENSE_SENSOR_STREAM_INGRESS_SLOTS
	int "Stream ingress slots"
	default 4
	range 2 64
	help
	  Complete-record handoff slots. ECG's default is four 4096-byte records;
	  PPG overrides the record storage size and slot count in its application.

config MSENSE_SENSOR_STREAM_INGRESS_RECORD_BYTES
	int "Stream ingress record bytes"
	default 4096
	range 16 4096
	help
	  Storage reserved by each complete-record handoff slot. It must be at
	  least the selected product record size.

config MSENSE_SENSOR_STREAM_NO_PROGRESS_TIMEOUT_MS
	int "Stream no-progress timeout (ms)"
	default 15000
	range 1000 60000
	help
	  End a stalled v0 stream when notifications remain ready or in flight
	  without a completion for this duration. Recording continues independently.

endif # MSENSE_SENSOR_STREAM
```
